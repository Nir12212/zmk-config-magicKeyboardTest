#include <dt-bindings/zmk/matrix_transform.h>

/ {
    chosen {
        zmk,kscan = &kscan0;
    };

    kscan0: kscan {
        compatible = "zmk,kscan-gpio-matrix";
        rows = <1>;
        columns = <1>;
        row-gpios = <&gpio0 2 GPIO_ACTIVE_HIGH> ;
        col-gpios = <&gpio0 3 GPIO_ACTIVE_HIGH>,;
    };
    default_transform: keymap_transform_0 {
    compatible = "zmk,matrix-transform";
    columns = <1>;
    rows = <1>;
    map = <
        RC(0,0)
    >;
};

};
